## c/Kconfig
```kconfig
menu "bysound"
    choice BYSOUND_DEMOD_ENGINE
        prompt "Demodulator per-tone energy engine"
        default BYSOUND_DEMOD_ENGINE_FFT if IDF_TARGET_ESP32S3 || IDF_TARGET_ESP32 || IDF_TARGET_ESP32P4
        default BYSOUND_DEMOD_ENGINE_GOERTZEL
        help
            float32 FFT (chips with an FPU: ESP32-S3, ESP32, P4) or fixed-point Goertzel (C3, C6, S2, H2: no FPU).
        config BYSOUND_DEMOD_ENGINE_FFT
            bool "float32 FFT"
        config BYSOUND_DEMOD_ENGINE_GOERTZEL
            bool "Integer Goertzel"
    endchoice
    config BYSOUND_DEMOD_ROBUST
        bool "Demodulator supports the robust profile (double window, about 20 KB more state)"
        default n
    config BYSOUND_DEMOD_LOW_BANK
        bool "Demodulator supports the audible band (64 more history bins, about 10 KB more)"
        default n
    config BYSOUND_DEMOD_MAX_RATE
        int "Maximum demodulator sample rate (Hz)"
        default 48000
        range 8000 96000
endmenu
```

## esp32/main/Kconfig.projbuild
```kconfig
menu "bysound demo"

    choice BYSOUND_DEMO_SECURITY
        prompt "Security level (docs/SESSION.md section 7)"
        default BYSOUND_DEMO_SECURITY_MAXIMUM
        help
            maximum (default): pre-listen 3-4.2 s, detects other emitters, risk frames, confirm watch. standard: 2-2.6 s. basic: integrity only (1 s pre-listen
            for the ambient check, nothing else heard is acted on).
        config BYSOUND_DEMO_SECURITY_BASIC
            bool "basic"
        config BYSOUND_DEMO_SECURITY_STANDARD
            bool "standard"
        config BYSOUND_DEMO_SECURITY_MAXIMUM
            bool "maximum"
    endchoice

    config BYSOUND_DEMO_FIXED_BAND
        bool "Send on one band only (no channel ladder, no calibration)"
        default n
        help
            By default the sender picks a channel by the noise it measures and steps down the ladder top, high, upper, mid until it is acknowledged
            (docs/SESSION.md section 9). Listening always covers the four ladder bands.

    config BYSOUND_DEMO_BAND
        int "Fixed band (0 top, 1 high, 2 upper, 3 mid)"
        default 0
        range 0 3
        depends on BYSOUND_DEMO_FIXED_BAND

    config BYSOUND_DEMO_ROBUST_RX
        bool "Also listen to the robust profile (second demodulator)"
        default y
        select BYSOUND_DEMOD_ROBUST
        help
            The sender goes robust after 6 repetitions without an ack (or in noise), so a receiver that only hears the normal profile misses it.
            Costs about 130 KB of RAM for the two demodulators in total (the robust-capable state is about 66 KB each; one demodulator of the normal
            profile only is about 45 KB).

    config BYSOUND_DEMO_TEXT
        string "Text sent when the button is pressed"
        default "hello from esp32"

    config BYSOUND_DEMO_TX_LEVEL
        int "Output level (percent of full scale)"
        default 100
        range 1 100
        help
            The modem is meant to run at full scale; lower this only if your amplifier clips.

    config BYSOUND_DEMO_MIC_GAIN_SHIFT
        int "Digital microphone gain (left shift, 2^n)"
        default 2
        range 0 6
        help
            The INMP441 is quiet at 18 kHz. The 16 top bits of its 24-bit sample are multiplied by 2^n (with saturation).

    config BYSOUND_DEMO_RX_MAX_BYTES
        int "Largest received payload (packed bytes)"
        default 1024
        range 48 12244
        help
            Size of the buffer handed to the demodulator. A frame that does not fit is dropped.

    config BYSOUND_DEMO_BUTTON_GPIO
        int "Button GPIO (active low)"
        default 0
        help
            GPIO0 is the BOOT button on most ESP32-S3 dev boards.

    menu "Microphone (INMP441, I2S port 1)"
        config BYSOUND_DEMO_MIC_BCLK
            int "SCK (bit clock) GPIO"
            default 4
        config BYSOUND_DEMO_MIC_WS
            int "WS (word select) GPIO"
            default 5
        config BYSOUND_DEMO_MIC_SD
            int "SD (data out of the microphone) GPIO"
            default 6
    endmenu

    menu "Amplifier (MAX98357A, I2S port 0)"
        config BYSOUND_DEMO_SPK_BCLK
            int "BCLK GPIO"
            default 15
        config BYSOUND_DEMO_SPK_WS
            int "LRC (word select) GPIO"
            default 16
        config BYSOUND_DEMO_SPK_DIN
            int "DIN (data into the amplifier) GPIO"
            default 17
    endmenu

endmenu
```

## examples/esp32-wifi-setup/main/Kconfig.projbuild
```kconfig
# Pins, security level, gain... of the audio code are those of the esp32 demo.
rsource "../../../esp32/main/Kconfig.projbuild"

menu "Wi-Fi setup by sound"
    config WIFISETUP_ALLOW_PLAIN
        bool "Accept plain WIFI:T:WPA;S:...;P:...;; texts (no code, credentials travel in clear)"
        default n
        help
            Off (default): only protected texts (BSW1|salt|iv|ciphertext, opened with the one-time code printed on the serial log) are accepted.
    config WIFISETUP_CODE_SECONDS
        int "One-time code validity (seconds)"
        default 120
    config WIFISETUP_MAX_ATTEMPTS
        int "Wrong-code attempts before a new code is issued"
        default 3
    config WIFISETUP_CONNECT_TIMEOUT_S
        int "Seconds to wait for an IP address before giving up"
        default 20
endmenu
```

## examples/store-presence/esp32-beacon/main/Kconfig.projbuild
```kconfig
# Speaker pins, output level... are those of the esp32 demo (the microphone pins are not used by this project).
rsource "../../../../esp32/main/Kconfig.projbuild"

menu "Store presence beacon"
    config PRESENCE_STORE_ID
        string "Store id (1-16 characters: letters, digits, - or _)"
        default "cafe42"
    config PRESENCE_STORE_KEY
        string "Store key (HMAC-SHA256 secret)"
        default "demo-store-key-do-not-use-in-production"
        help
            DEMO VALUE. Whoever has this key can forge tokens for the store. A real deployment generates a random key per store, keeps it in
            the store's backend and flashes it into this device (NVS or a protected flash partition), not in the source tree.
    config PRESENCE_INTERVAL_S
        int "Seconds between two broadcasts (start to start)"
        default 6
        range 3 30
    choice PRESENCE_TIME
        prompt "Where the beacon gets the time from"
        default PRESENCE_TIME_FIXED
        config PRESENCE_TIME_FIXED
            bool "Fixed epoch + uptime (offline demo)"
            help
                No network: the clock starts at PRESENCE_EPOCH when the board boots and counts uptime. Set the epoch to the time of flashing
                (date +%s) and expect the clock to be off by the time since flashing: the customer accepts only windows within 30-90 s,
                so for an offline demo power the board right after building, or use SNTP.
        config PRESENCE_TIME_SNTP
            bool "SNTP over Wi-Fi (real time)"
    endchoice
    config PRESENCE_EPOCH
        int "Epoch (unix seconds) the clock starts at when the board boots"
        default 1790000000
        depends on PRESENCE_TIME_FIXED
    config PRESENCE_WIFI_SSID
        string "Wi-Fi SSID (SNTP)"
        depends on PRESENCE_TIME_SNTP
    config PRESENCE_WIFI_PASSWORD
        string "Wi-Fi password (SNTP)"
        depends on PRESENCE_TIME_SNTP
    config PRESENCE_SNTP_SERVER
        string "SNTP server"
        default "pool.ntp.org"
        depends on PRESENCE_TIME_SNTP
endmenu
```
